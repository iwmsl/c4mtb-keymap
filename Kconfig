## Kconfig
```kconfig
menuconfig C4MTB_TELEMETRY
    bool "C4MTB privacy-preserving usage counters"
    depends on SETTINGS
    depends on ZMK_SPLIT_ROLE_CENTRAL
    depends on ZMK_POINTING
    help
      Store cumulative physical-position, layer, mouse-button, and pointing
      counters on the central half. No characters, sequences, application
      names, or timestamps are recorded.

if C4MTB_TELEMETRY

config C4MTB_TELEMETRY_SAVE_INTERVAL_MINUTES
    int "Telemetry save interval in minutes"
    range 5 1440
    default 30
    help
      Minimum interval between writes to settings storage while counters are
      changing. Longer intervals reduce flash wear but increase the amount of
      data that can be lost if power is removed.

config C4MTB_TELEMETRY_EXPORT
    bool "Periodically print telemetry to the console"
    default n
    help
      Print a machine-readable snapshot every five seconds. Enable this only
      in the dedicated export firmware used on a personal computer.

endif
```

## boards/shields/c4mtb/Kconfig.defconfig
```kconfig
if SHIELD_C4MTB_R

config ZMK_KEYBOARD_NAME
    default "c4mtb"

config ZMK_SPLIT_ROLE_CENTRAL
    default y

config INPUT
    default y

config ZMK_POINTING
    default y

config SPI
    default y

config PMW3610
    default y

endif

if SHIELD_C4MTB_L

# peripheral側も名前を持たせ、BLEスキャナで左手を識別できるようにする。
# ホストに見える名前はcentral(右手)の"c4mtb"のまま。
config ZMK_KEYBOARD_NAME
    default "c4mtb_L"

endif

if SHIELD_C4MTB_R || SHIELD_C4MTB_L

config ZMK_SPLIT
    default y

config NFCT_PINS_AS_GPIOS
    default y

endif
```

## boards/shields/c4mtb/Kconfig.shield
```kconfig
config SHIELD_C4MTB_R
    def_bool $(shields_list_contains,c4mtb_r)

config SHIELD_C4MTB_L
    def_bool $(shields_list_contains,c4mtb_l)
```

## dts/bindings/behaviors/c4mtb,behavior-cursor-speed.yaml
```yaml
description: Toggle between the standard and fast cursor speeds

compatible: "c4mtb,behavior-cursor-speed"

include: zero_param.yaml
```

## dts/bindings/input_processors/c4mtb,input-processor-telemetry.yaml
```yaml
description: C4MTB privacy-preserving pointing telemetry processor

compatible: "c4mtb,input-processor-telemetry"

include: ip_one_param.yaml
```
